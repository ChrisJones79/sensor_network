## esp32_c3_sensor/sdkconfig.defaults
```kconfig
# Bluetooth (BLE only — ESP32-C3 has no classic BT)
CONFIG_BT_ENABLED=y
CONFIG_BT_CONTROLLER_ENABLED=y
CONFIG_BT_BLUEDROID_ENABLED=y
CONFIG_BT_BLE_ENABLED=y
CONFIG_BT_BLE_42_FEATURES_SUPPORTED=y

# Use a smaller BT controller task stack to save RAM
CONFIG_BT_CTRL_BLE_MAX_CONN=3
```
